## configs/rk322x_defconfig
```kconfig
BR2_arm=y
BR2_cortex_a7=y
BR2_ARM_FPU_NEON_VFPV4=y
BR2_PACKAGE_HOST_LINUX_HEADERS_CUSTOM_5_10=y
BR2_SYSTEM_DHCP="eth0"
BR2_ROOTFS_POST_BUILD_SCRIPT="$(BR2_EXTERNAL_ROCKCHIP_ATV_BOX_PATH)/board/rockchip/rk322x/post-build.sh"
BR2_ROOTFS_POST_IMAGE_SCRIPT="support/scripts/genimage.sh"
BR2_ROOTFS_POST_SCRIPT_ARGS="-c $(BR2_EXTERNAL_ROCKCHIP_ATV_BOX_PATH)/board/rockchip/rk322x/genimage.cfg"
BR2_GLOBAL_PATCH_DIR="$(BR2_EXTERNAL_ROCKCHIP_ATV_BOX_PATH)/board/rockchip/common/patches $(BR2_EXTERNAL_ROCKCHIP_ATV_BOX_PATH)/board/rockchip/rk322x/patches"
BR2_LINUX_KERNEL=y
BR2_LINUX_KERNEL_CUSTOM_VERSION=y
BR2_LINUX_KERNEL_CUSTOM_VERSION_VALUE="5.10.185"
BR2_LINUX_KERNEL_PATCH="$(BR2_EXTERNAL_ROCKCHIP_ATV_BOX_PATH)/board/rockchip/common/kernel-510-patches $(BR2_EXTERNAL_ROCKCHIP_ATV_BOX_PATH)/board/rockchip/rk322x/kernel-510-patches"
BR2_LINUX_KERNEL_USE_CUSTOM_CONFIG=y
BR2_LINUX_KERNEL_CUSTOM_CONFIG_FILE="$(BR2_EXTERNAL_ROCKCHIP_ATV_BOX_PATH)/board/rockchip/rk322x/linux.arm.conf"
BR2_LINUX_KERNEL_DTS_SUPPORT=y
BR2_LINUX_KERNEL_INTREE_DTS_NAME="rk322x-box"
BR2_LINUX_KERNEL_NEEDS_HOST_OPENSSL=y
BR2_TARGET_ROOTFS_EXT2=y
BR2_TARGET_ROOTFS_EXT2_4=y
BR2_TARGET_ROOTFS_EXT2_SIZE="512M"
# BR2_TARGET_ROOTFS_TAR is not set
BR2_PACKAGE_HOST_DOSFSTOOLS=y
BR2_PACKAGE_HOST_GENEXT2FS=y
BR2_PACKAGE_HOST_GENIMAGE=y
BR2_PACKAGE_HOST_MTOOLS=y
```
